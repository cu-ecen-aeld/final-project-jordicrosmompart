## base_external/Config.in
```kconfig
source "$BR2_EXTERNAL_project_base_PATH/package/samplelkm/Config.in"
source "$BR2_EXTERNAL_project_base_PATH/package/uartlkm/Config.in"
source "$BR2_EXTERNAL_project_base_PATH/package/hm11lkm/Config.in"
source "$BR2_EXTERNAL_project_base_PATH/package/heartrate-measurement-server/Config.in"
```

## base_external/package/hm11lkm/Config.in
```kconfig
config BR2_PACKAGE_HM11LKM
	bool "HM11LKM"
	depends on BR2_LINUX_KERNEL
	help
	  Includes the hm-11 LKM
```

## buildroot_client/base_external/package/heartrate-measurement-client/Config.in
```kconfig
config BR2_PACKAGE_HEARTRATE_MEASUREMENT_CLIENT
	bool "heartrate-measurement-client"
	help
	  Includes the user code that interacts with the  HM-11 driver
```

## buildroot_client/base_external/package/samplelkm/Config.in
```kconfig
config BR2_PACKAGE_SAMPLELKM
	bool "SAMPLELKM"
	depends on BR2_LINUX_KERNEL
	help
	  Includes the char device LKM
```

## buildroot_server/base_external/package/heartrate-measurement-server/Config.in
```kconfig
config BR2_PACKAGE_HEARTRATE_MEASUREMENT_SERVER
	bool "heartrate-measurement-server"
	help
	  Includes the user code that interacts with the  HM-11 driver
```

## buildroot_server/base_external/package/hm11extras/Config.in
```kconfig
config BR2_PACKAGE_HM11EXTRAS
	bool "hm11extras"
	help
	  Includes user code that tests extra HM11 features
```

## buildroot_server/base_external/package/uartlkm/Config.in
```kconfig
config BR2_PACKAGE_UARTLKM
	bool "UARTLKM"
	depends on BR2_LINUX_KERNEL
	help
	  Includes the UART LKM
```
